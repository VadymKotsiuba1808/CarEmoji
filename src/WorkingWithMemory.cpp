#include <WorkingWithMemory.h>
#include <BitmapImages.h>

File myFile;
bool state = true;
constexpr int counter = 5;
uint16_t DefaultBitmap[1024] = {0xFFFF, 0xFFFF, 0x0000, 0x0000, 0x0000, 0x0000, 0x0000, 0x0000, 0x0000, 0x0000, 0x0000, 0x0000, 0x0000, 0x0000, 0x0000, 0x0000, 0x0000, 0x0000, 0x0000, 0x0000, 0x0000, 0x0000, 0x0000, 0x0000, 0x0000, 0x0000, 0x0000, 0x0000, 0x0000, 0x0000, 0x0000, 0x0000,
                                0x0000, 0x0000, 0xFFFF, 0xFFFF, 0x0000, 0x0000, 0x0000, 0x0000, 0x0000, 0x0000, 0x0000, 0x0000, 0x0000, 0x0000, 0x0000, 0x0000, 0x0000, 0x0000, 0x0000, 0x0000, 0x0000, 0x0000, 0x0000, 0x0000, 0x0000, 0x0000, 0x0000, 0x0000, 0x0000, 0x0000, 0x0000, 0x0000,
                                0x0000, 0x0000, 0xFFFF, 0xFFFF, 0xFFFF, 0x0000, 0x0000, 0x0000, 0x0000, 0x0000, 0x0000, 0x0000, 0x0000, 0x0000, 0x0000, 0x0000, 0x0000, 0x0000, 0x0000, 0x0000, 0x0000, 0x0000, 0x0000, 0x0000, 0x0000, 0x0000, 0x0000, 0x0000, 0x0000, 0x0000, 0x0000, 0x0000,
                                0x0000, 0x0000, 0x0000, 0x0000, 0xFFFF, 0xFFFF, 0xFFFF, 0xFFFF, 0xFFFF, 0xFFFF, 0xFFFF, 0xFFFF, 0xFFFF, 0xFFFF, 0xFFFF, 0xFFFF, 0xFFFF, 0xFFFF, 0xFFFF, 0xFFFF, 0xFFFF, 0xFFFF, 0xFFFF, 0xFFFF, 0xFFFF, 0x0000, 0x0000, 0x0000, 0x0000, 0x0000, 0x0000, 0x0000,
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                                0x0000, 0x0000, 0x0000, 0x0000, 0x0000, 0x0000, 0x0000, 0x0000, 0x0000, 0x0000, 0x0000, 0x0000, 0x0000, 0x0000, 0x0000, 0x0000, 0x0000, 0x0000, 0x0000, 0x0000, 0x0000, 0x0000, 0x0000, 0x0000, 0x0000, 0x0000, 0x0000, 0x0000, 0x0000, 0x0000, 0x0000, 0xFFFF};


bool InitSPIFFS()
{
    if (!SPIFFS.begin(true))
    {
        state = false;
        Serial.println("TEST_LOG: Error init SPIFFS");

        // якщо невдалось змонтувати файлову систему
        // Розділи для байтових масивів
        for (size_t i = 0; i < counter; i++)
        {
            if (!SPIFFS.exists("/FAV_" + String(counter)))
            {
                if (!SPIFFS.mkdir("/FAV_" + String(counter)))
                {
                    Serial.println("TEST_LOG: Error when creation partition for images");
                }
            }
        }

        // Розділ для текстових стрічок
        if (!SPIFFS.exists("/Massage"))
        {
            if (!SPIFFS.mkdir("/Massage"))
            {
                Serial.println("TEST_LOG: Error when creation partition for text lines");
            }
        }

        // Розділ для цілочисельних значень
        if (!SPIFFS.exists("/Brightness"))
        {
            if (!SPIFFS.mkdir("/Brightness"))
            {
                Serial.println("TEST_LOG: Error when creation partition for brightness");
            }
        }

        // Розділ для першого запуску
        if (!SPIFFS.exists("/FirstRun"))
        {
            Serial.println("TEST_LOG: FirstRun not exist");
            if (!SPIFFS.mkdir("/FirstRun"))
            {
                Serial.println("TEST_LOG: Error when creation partition for FirstRun");
            }
        }
    }

    SPIFFS.end();
    SPIFFS.begin(true);

    uint8_t status_first_run = ReadFirstRun();

    if(status_first_run != 1)
    {
        Serial.println("TEST_LOG: It's first run, write default values and images");
        // записуєм дефолтні данні в комірки
        WriteFirstRun();
        WriteMassage("");
        WriteBrightness(100);
        for (size_t i = 0; i < counter; i++)
        {
            WriteFile(OtherBitmap[i], i);
        }
    }

    return state;
}

void GetByteArray(uint16_t *hArray, byte *bArr)
{
    Serial.println("In getbyteArray");
    uint16_t counter = 0;
    for (int i = 0; i < 2048; i++)
    {
        if ((i % 2) == 0)
        {
            bArr[i] = hArray[counter] >> 8;
            // Serial.printf("HEX is %i \n", hArray[counter]);
        }
        else
        {
            bArr[i] = hArray[counter];
            counter++;
        }
        // Serial.printf("byte is %i \n", bArr[i]);
    }
}

void GetHexArray(uint16_t *hArray, byte *bArr)
{
    uint16_t counter = 0;
    for (int i = 0; i < 2048; i++)
    {
        if ((i % 2) == 0)
        {
            hArray[counter] = bArr[i] << 8;
        }
        else
        {
            hArray[counter] |= bArr[i];
            counter++;
        }
    }
}
extern uint16_t DefaultBitmap[1024];
void ReadFile(uint16_t *hArr, int key)
{

    byte bArr[2048];
    String name;
    name = ("/FAV_" + String(key));
    if(!SPIFFS.exists(name)){
        Serial.println("File not found...");
        hArr = DefaultBitmap;
        return;
    }
    Serial.printf("Read name is : %s\n", name);
    myFile = SPIFFS.open(name, FILE_READ);
    myFile.read(bArr, 2048);
    myFile.close();
    // memcpy(hArr, bArr, 2048);
    GetHexArray(hArr, bArr);
}

// void RedBatData(float *hArr)
// {
//     myFile = SPIFFS.open("/BAT_ARR", FILE_READ);
//     myFile.read(hArr, 2048);
//     myFile.close();

// }

// void WritebatData(float *hArr)
// {

// }

void WriteFile(uint16_t *hArr, int key)
{
    byte bArr[2048];
    GetByteArray(hArr, bArr);
    String name;
    name = ("/FAV_" + String(key));
    Serial.printf("Write name is : %s\n", name);
    myFile = SPIFFS.open(name, FILE_WRITE);
    myFile.write(bArr, 2048);
    myFile.close();
}

int ReadBrightness()
{
    int brightness;
    myFile = SPIFFS.open("/Brightness", FILE_READ);
    brightness = myFile.read();
    myFile.close();
    return brightness;
}

void WriteBrightness(int value)
{
    value = value > 100 ? 100 : value < 10 ? 10
                                           : value; // constrain(value, 10, 100);
    myFile = SPIFFS.open("/Brightness", FILE_WRITE);
    myFile.write((uint8_t)value);
    log_e("write value is %i", value);
    myFile.close();
}

void WriteMassage(String value)
{
    myFile = SPIFFS.open("/Massage", FILE_WRITE);
    myFile.print(value);
    myFile.close();
}

String ReadMassage()
{
    String mes;
    myFile = SPIFFS.open("/Massage", FILE_READ);
    mes = myFile.readString();
    myFile.close();
    return mes;
}

int ReadFirstRun()
{
    int status;
    myFile = SPIFFS.open("/FirstRun", FILE_READ);
    status = myFile.read();
    myFile.close();
    return status;
}

void WriteFirstRun()
{
    myFile = SPIFFS.open("/FirstRun", FILE_WRITE);
    myFile.write((uint8_t)1U);
    myFile.close();
}